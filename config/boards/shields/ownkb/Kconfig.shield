## config/boards/shields/ownkb/Kconfig.shield
```kconfig
config SHIELD_OWNKB_LEFT
    def_bool $(shields_list_contains,ownkb_left)

config SHIELD_OWNKB_RIGHT
    def_bool $(shields_list_contains,ownkb_right)
```

## config/west.yml
```yaml
manifest:
  remotes:
    - name: zmkfirmware
      url-base: https://github.com/zmkfirmware
    - name: petejohanson
      url-base: https://github.com/petejohanson
  projects:
    - name: zmk
      import: app/west.yml
      remote: zmkfirmware
      revision: main
  self:
    path: config
```
